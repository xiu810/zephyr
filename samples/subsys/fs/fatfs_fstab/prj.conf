## prj.conf
```kconfig
CONFIG_DISK_ACCESS=y
CONFIG_DISK_DRIVERS=y

CONFIG_LOG=y
CONFIG_LOG_MODE_MINIMAL=y

CONFIG_FILE_SYSTEM=y
CONFIG_FILE_SYSTEM_MKFS=y
CONFIG_FAT_FILESYSTEM_ELM=y
CONFIG_FS_FATFS_FSTAB_AUTOMOUNT=y

CONFIG_SDHC=y
CONFIG_SDMMC_SUBSYS=y
CONFIG_SPI=y
CONFIG_SPI_SDHC=y
CONFIG_ESP32_SPIM=y
CONFIG_LOG_DEFAULT_LEVEL=3
```

## app.overlay
```dts
/*
 * Copyright (c) 2025 Endress+Hauser AG
 *
 * SPDX-License-Identifier: Apache-2.0
 */

/ {
	fstab {
		compatible = "zephyr,fstab";
		ffs1: ffs1 {
			compatible = "zephyr,fstab,fatfs";
			automount;
			disk-access;
			mount-point = "/SD:";
		};
	};

	ramdisk0 {
		compatible = "zephyr,ram-disk";
		disk-name = "RAM";
		sector-size = <512>;
		sector-count = <128>;
	};
};
```

## src/main.c
```c
/*
 * Copyright (c) 2025 Endress+Hauser AG
 *
 * SPDX-License-Identifier: Apache-2.0
 */

#include <ff.h>
#include <zephyr/device.h>
#include <zephyr/fs/fs.h>
#include <zephyr/kernel.h>
#include <zephyr/logging/log.h>
#include <zephyr/storage/disk_access.h>

LOG_MODULE_REGISTER(main, LOG_LEVEL_INF);

#define AUTOMOUNT_NODE DT_NODELABEL(ffs1)
FS_FSTAB_DECLARE_ENTRY(AUTOMOUNT_NODE);

#define FILE_PATH "/SD:/hello.txt"

int main(void)
{
	struct fs_file_t file;
	int rc;
	static const char data[] = "Hello";
	/* You can get direct mount point to automounted node too */
	struct fs_mount_t *auto_mount_point = &FS_FSTAB_ENTRY(AUTOMOUNT_NODE);
	struct fs_dirent stat;

	fs_file_t_init(&file);

	rc = fs_open(&file, FILE_PATH, FS_O_CREATE | FS_O_WRITE);
	if (rc != 0) {
		LOG_ERR("Accessing filesystem failed");
		return rc;
	}

	rc = fs_write(&file, data, strlen(data));
	if (rc != strlen(data)) {
		LOG_ERR("Writing filesystem failed");
		return rc;
	}

	rc = fs_close(&file);
	if (rc != 0) {
		LOG_ERR("Closing file failed");
		return rc;
	}

	/* You can unmount the automount node */
	rc = fs_unmount(auto_mount_point);
	if (rc != 0) {
		LOG_ERR("Failed to do unmount");
		return rc;
	};

	/* And mount it back */
	rc = fs_mount(auto_mount_point);
	if (rc != 0) {
		LOG_ERR("Failed to remount the auto-mount node");
		return rc;
	}

	/* Is the file still there? */
	rc = fs_stat(FILE_PATH, &stat);
	if (rc != 0) {
		LOG_ERR("File status check failed %d", rc);
		return rc;
	}

	LOG_INF("Filesystem access successful");

	return 0;
}
```
